## br2_external/Config.in
```kconfig
comment "image and build configuration"

config BR2_EXTERNAL_X6100_SDCARD_PATH
	string "SD card block device to update (e.g. /dev/sdc)"
	default ""

config BR2_EXTERNAL_X6100_SDCARD_CLEAN
	bool "Wipe SD card before update"
	depends on BR2_EXTERNAL_X6100_SDCARD_PATH != ""

config BR2_EXTERNAL_X6100_PREINJECT_BY_DEFAULT
	bool "Preinject libqinj into x6100_ui_v100 with patchelf"
	depends on BR2_PACKAGE_LIBQINJ
	default y

config BR2_EXTERNAL_X6100_USE_STOCK_KERNEL
	bool "Use Xiegu-built kernel"
	depends on (BR2_LINUX_KERNEL_CUSTOM_VERSION_VALUE="5.8.9")
	
config BR2_EXTERNAL_X6100_OVERLAY_MODULES
	bool "Keep built modules unreleased by Xiegu"
	depends on BR2_EXTERNAL_X6100_USE_STOCK_KERNEL

comment "packages"

source "$BR2_EXTERNAL_X6100_WSPR_PATH/package/tty0tty/Config.in"
source "$BR2_EXTERNAL_X6100_WSPR_PATH/package/hamlib/Config.in"
source "$BR2_EXTERNAL_X6100_WSPR_PATH/package/hamlib-for-wsjtx/Config.in"
source "$BR2_EXTERNAL_X6100_WSPR_PATH/package/wsjtx/Config.in"
source "$BR2_EXTERNAL_X6100_WSPR_PATH/package/qinj/Config.in"
source "$BR2_EXTERNAL_X6100_WSPR_PATH/package/colorchanger/Config.in"
source "$BR2_EXTERNAL_X6100_WSPR_PATH/package/gammaray/Config.in"
source "$BR2_EXTERNAL_X6100_WSPR_PATH/package/python-tzlocal/Config.in"
source "$BR2_EXTERNAL_X6100_WSPR_PATH/package/python-backports-zoneinfo/Config.in"
source "$BR2_EXTERNAL_X6100_WSPR_PATH/package/python-pytz-deprecation-shim/Config.in"
source "$BR2_EXTERNAL_X6100_WSPR_PATH/package/python3-apscheduler/Config.in"
```

## br2_external/package/gammaray/Config.in
```kconfig
config BR2_PACKAGE_GAMMARAY
	bool "gammaray"
	depends on BR2_PACKAGE_QT5
	help
	  GammaRay Qt introspection probe.
```

## br2_external/package/libqinj/Config.in
```kconfig
config BR2_PACKAGE_LIBQINJ
        bool "libqinj"
        depends on BR2_PACKAGE_QT5
```

## br2_external/package/python-backports-zoneinfo/Config.in
```kconfig
config BR2_PACKAGE_PYTHON_BACKPORTS_ZONEINFO
	bool "python-backports-zoneinfo"
	depends on BR2_PACKAGE_PYTHON3
```

## br2_external/package/python-dbussy/Config.in
```kconfig
config BR2_PACKAGE_PYTHON_DBUSSY
	bool "python-dbussy"
	depends on BR2_PACKAGE_PYTHON3
```

## br2_external/package/python-pytz-deprecation-shim/Config.in
```kconfig
config BR2_PACKAGE_PYTHON_PYTZ_DEPRECATION_SHIM
	bool "python-pytz-deprecation-shim"
	depends on BR2_PACKAGE_PYTHON3
```

## br2_external/package/python-tzlocal/Config.in
```kconfig
config BR2_PACKAGE_PYTHON_TZLOCAL
	bool "python-tzlocal"
	depends on BR2_PACKAGE_PYTHON3
```

## br2_external/package/python3-apscheduler/Config.in
```kconfig
config BR2_PACKAGE_PYTHON3_APSCHEDULER
        bool "python3-apscheduler"
	depends on BR2_PACKAGE_PYTHON3
	select BR2_PACKAGE_PYTHON3_SETUPTOOLS
        help
                apscheduler for python
```

## br2_external/package/python3-tzlocal/Config.in
```kconfig
config BR2_PACKAGE_PYTHON3_TZLOCAL
        bool "python3-tzlocal"
	depends on BR2_PACKAGE_PYTHON3
        help
                apscheduler for python
```

## br2_external/package/qinj/Config.in
```kconfig
config BR2_PACKAGE_QINJ
	bool "qinj"
	depends on BR2_PACKAGE_QT5
	depends on BR2_PACKAGE_PYTHON3
	select BR2_PACKAGE_QINJ_CONSOLE
	select BR2_PACKAGE_LIBQINJ

if BR2_PACKAGE_QINJ
  source "$BR2_EXTERNAL_X6100_WSPR_PATH/package/qinj/libqinj/Config.in"
  source "$BR2_EXTERNAL_X6100_WSPR_PATH/package/qinj/qinj-console/Config.in"
endif
```

## br2_external/package/tty0tty/Config.in
```kconfig
config BR2_PACKAGE_TTY0TTY
	bool "tty0tty"
	depends on BR2_LINUX_KERNEL
	help
	  TTY0TTY module
```

## br2_external/package/wsjtx/Config.in
```kconfig
config BR2_PACKAGE_WSJTX
	bool "WSJT-X"
	depends on BR2_PACKAGE_FFTW_SINGLE
	depends on BR2_PACKAGE_BOOST_LOG
	select BR2_PACKAGE_HAMLIB_FOR_WSJTX
	help
	  wsprd (from WSTJ-X)
```
